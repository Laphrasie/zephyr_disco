## build/Kconfig/boards/Kconfig.defconfig
```kconfig
# Load Zephyr board defconfig descriptions.
osource "/home/arnaud/zephyrproject/zephyr/boards/st/stm32h747i_disco/Kconfig.defconfig"
```

## build/Kconfig/boards/Kconfig.stm32h747i_disco
```kconfig
# Load board Kconfig descriptions.
osource "/home/arnaud/zephyrproject/zephyr/boards/st/stm32h747i_disco/Kconfig.stm32h747i_disco"
```

## build/Kconfig/boards/Kconfig.sysbuild
```kconfig
# Load Sysbuild board Kconfig descriptions.
osource "/home/arnaud/zephyrproject/zephyr/boards/st/stm32h747i_disco/Kconfig.sysbuild"
```
